## config/boards/shields/KConfig.shield
```kconfig
config SHIELD_BOTS40_R
    def_bool $(shields_list_contains,bots40_R)

config SHIELD_BOTS40_L
    def_bool $(shields_list_contains,bots40_L)
```

## config/boards/shields/bots40/Kconfig.defconfig
```kconfig
if SHIELD_BOTS40_R

config ZMK_KEYBOARD_NAME
    default "bots40_R"

config ZMK_SPLIT
    default y

config ZMK_SPLIT_ROLE_CENTRAL
    default y

endif

if SHIELD_BOTS40_L

config ZMK_KEYBOARD_NAME
    default "bots40_L"

config ZMK_SPLIT
    default y

endif
```
